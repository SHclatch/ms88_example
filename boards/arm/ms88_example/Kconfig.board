## boards/arm/ms88_example/Kconfig.board
```kconfig
config BOARD_MS88_EXAMPLE
    bool "MS88SF21 Example"
    depends on SOC_NRF52840_QIAA
```

## boards/arm/ms88_example/Kconfig.defconfig
```kconfig
if BOARD_MS88_EXAMPLE

config ZMK_KEYBOARD_NAME
    default "MS88SF21_EXAMPLE"

if USB_DEVICE_STACK

config USB_NRFX
    default y

endif # USB_DEVICE_STACK

config BT_CTLR
    default BT

endif # BOARD_MS88_EXAMPLE
```

## boards/arm/ms88_example/board.yml
```yaml
board:
  name: ms88_example
  vendor: minew
  socs:
    - name: nrf52840
      variants:
        - name: zmk
```

## boards/arm/ms88_example/ms88_example_defconfig
```kconfig
CONFIG_SOC_SERIES_NRF52X=y
CONFIG_SOC_NRF52840_QIAA=y
CONFIG_BOARD_MS88_EXAMPLE=y

CONFIG_ARM_MPU=y
CONFIG_PINCTRL=y

CONFIG_GPIO=y
CONFIG_INPUT=y
CONFIG_SPI=y

CONFIG_USE_DT_CODE_PARTITION=y
CONFIG_BUILD_OUTPUT_UF2=y

CONFIG_MPU_ALLOW_FLASH_WRITE=y
CONFIG_NVS=y
CONFIG_SETTINGS_NVS=y
CONFIG_FLASH=y
CONFIG_FLASH_PAGE_LAYOUT=y
CONFIG_FLASH_MAP=y

CONFIG_ZMK_USB=y
CONFIG_ZMK_BLE=y
CONFIG_ZMK_KSCAN_MATRIX_POLLING=y
CONFIG_PMW3610=y
CONFIG_EC11=y
CONFIG_EC11_TRIGGER_GLOBAL_THREAD=y
```
